## base_external/package/Config.in
```kconfig
menu "AI Tutor packages"
	source "$BR2_EXTERNAL_PIASSISTANT_PATH/package/led-driver/Config.in"
	source "$BR2_EXTERNAL_PIASSISTANT_PATH/package/aitutor/Config.in"
	source "$BR2_EXTERNAL_PIASSISTANT_PATH/package/aitutor-test/Config.in"
endmenu

menu "AI Models and Tools"
	source "$BR2_EXTERNAL_PIASSISTANT_PATH/package/llama-cpp/Config.in"
	source "$BR2_EXTERNAL_PIASSISTANT_PATH/package/whisper-cpp/Config.in"
	source "$BR2_EXTERNAL_PIASSISTANT_PATH/package/piper/Config.in"
	source "$BR2_EXTERNAL_PIASSISTANT_PATH/package/ai-models/Config.in"
endmenu
```

## base_external/package/ai-models/Config.in
```kconfig
config BR2_PACKAGE_AI_MODELS
	bool "ai-models"
	help
	  AI models downloaded from HuggingFace
	  - TinyLlama 1.1B
	  - Whisper tiny
	  - Piper voice
```

## base_external/package/aitutor-test/Config.in
```kconfig
config BR2_PACKAGE_AITUTOR_TEST
	bool "aitutor-test"
	select BR2_PACKAGE_LED_DRIVER
	help
	  Test utilities for AI Tutor components
```

## base_external/package/aitutor/Config.in
```kconfig
config BR2_PACKAGE_AITUTOR
	bool "aitutor"
	select BR2_PACKAGE_LED_DRIVER
	help
	  AI-powered voice tutor application
```

## base_external/package/led-driver/Config.in
```kconfig
config BR2_PACKAGE_LED_DRIVER
	bool "led-driver"
	help
	  Kernel module for dual GPIO control
```

## base_external/package/piper/Config.in
```kconfig
config BR2_PACKAGE_PIPER
	bool "piper"
	help
	  Fast text-to-speech system for ARM64
	  https://github.com/rhasspy/piper
```

## base_external/package/whisper-cpp/Config.in
```kconfig
config BR2_PACKAGE_WHISPER_CPP
	bool "whisper-cpp"
	help
	  Whisper speech-to-text inference for ARM64
	  https://github.com/ggerganov/whisper.cpp
```
